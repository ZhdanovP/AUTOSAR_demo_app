AUTOSAR XML (schema 00048)
package /ara/demo/timing_config
  someip sd server service instance config ServerSomeIpSdConfig: initial-offer-behavior={initial-delay-max-value=0.1, initial-delay-min-value=0.01, initial-repetitions-base-delay=0.2, initial-repetitions-max=3}, offer-cyclic-delay=2.0, request-response-delay={max-value=1.5, min-value=1.5}, service-offer-time-to-live=10
  someip sd client service instance config ClientSomeIpSdConfig: initial-find-behavior={initial-delay-max-value=0.1, initial-delay-min-value=0.01, initial-repetitions-base-delay=0.2, initial-repetitions-max=3}, service-find-time-to-live=10
