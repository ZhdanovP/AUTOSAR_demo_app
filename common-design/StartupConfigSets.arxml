AUTOSAR XML (schema 00048)
package /ara/processes
  startup config set startup_set
    startup config startup_config: scheduling-policy=SCHEDULING-POLICY-ROUND-ROBIN, scheduling-priority=12
