AUTOSAR XML (schema 00048)
package /ara/demo/network
  ethernet cluster DefaultEthCluster
    ethernet physical channel DefaultPhysChannel
      network endpoint ServiceDiscoveryEndpoint: network-endpoint-addresses=ipv-4-configuration={ipv-4-address=224.224.224.245, ipv-4-address-source=FIXED}
      network endpoint MainEcuEndpoint: network-endpoint-addresses=ipv-4-configuration={default-gateway=192.168.7.1, ipv-4-address=192.168.7.2, ipv-4-address-source=FIXED, network-mask=255.255.255.0}
      network endpoint SecondaryEcuEndpoint: network-endpoint-addresses=ipv-4-configuration={default-gateway=192.168.7.1, ipv-4-address=192.168.7.4, ipv-4-address-source=FIXED, network-mask=255.255.255.0}
