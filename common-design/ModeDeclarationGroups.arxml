AUTOSAR XML (schema 00048)
package /ara/demo/function_group_modes
  mode declaration group AdaptiveAppGroup: initial-mode=AdaptiveAppGroup/Off
    mode Off
    mode On
  mode declaration group MachineState: initial-mode=Startup
    7 x mode:
      Driving
      Leaving
      Off
      Parking
      Restart
      Shutdown
      Startup
