AUTOSAR XML (schema 00048)
package /ara/demo/functionaltests_mapping
  process to machine mapping set FunctionalTestsInstanceToMainEcuMappingSet
    process to machine mapping FunctionalTestsInstanceToMainEcuMapping: machine=MainEcu, process=functionaltests_instance
  service instance to port prototype mapping FunctionalTestsInstanceToWeatherServicePortMapping: port-prototype=root_swc.WeatherServiceRPort, process=functionaltests_instance_design, service-instance=WeatherServiceRequired
  service instance to port prototype mapping WeatherProviderInstanceToTemperatureServicePortMapping: port-prototype=root_swc.TemperatureServicePPort, process=functionaltests_instance_design, service-instance=TemperatureServiceProvided
  someip service instance to machine mapping WeatherProviderInstanceToMachineMapping: communication-connector=EthCommunicationConnector, service-instance=[WeatherServiceRequired, TemperatureServiceProvided], udp-port=5000
