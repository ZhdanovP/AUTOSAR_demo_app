AUTOSAR XML (schema 00048)
package /ara/processes
  process functionaltests_instance: design=functionaltests_instance_design, executable=functionaltests_exe, log-trace-default-log-level=VERBOSE, log-trace-file-path=/var/redirected/functionaltests_instance, log-trace-log-modes=[NETWORK, CONSOLE], log-trace-process-desc=FunctionalTests, log-trace-process-id=WRPR, state-dependent-startup-config{function-group-state=AdaptiveAppGroup.On, resource-group=Resource_group_1, startup-config=startup_config}
  process design functionaltests_instance_design: executable=functionaltests_exe
