AUTOSAR XML (schema 00048)
package /ara/demo/statemanager_instance
  process to machine mapping set StateManagerInstanceToMainEcuMappingSet
    process to machine mapping StateManagerInstanceToMainEcuMapping: machine=MainEcu, process=statemanager_instance
