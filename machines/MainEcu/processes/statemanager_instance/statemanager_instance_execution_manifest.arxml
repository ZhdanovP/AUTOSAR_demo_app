AUTOSAR XML (schema 00048)
package /ara/processes
  process statemanager_instance:
    executable=statemanager
    log-trace-default-log-level=VERBOSE
    log-trace-file-path=/var/redirected/statemanager_instance
    log-trace-log-modes=[NETWORK, CONSOLE]
    log-trace-process-desc=DemoStateManager1
    log-trace-process-id=DSM1
    state-dependent-startup-config{function-group-state=[MachineState.Startup, MachineState.Driving, MachineState.Parking, MachineState.Leaving], resource-group=Resource_group_1, startup-config=startup_config}
