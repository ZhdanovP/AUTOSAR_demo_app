AUTOSAR XML (schema 00048)
package /ara/demo/temperatureprovider_instance
  provided someip service instance TemperatureServiceProvided: service-interface-deployment=TemperatureServiceSomeIp, sd-server-config=ServerSomeIpSdConfig, service-instance-id=28
