AUTOSAR XML (schema 00048)
package /ara/processes
  process temperatureprovider_instance:
    design=temperatureprovider_instance_design
    executable=temperatureprovider_exe
    log-trace-default-log-level=VERBOSE
    log-trace-file-path=/var/redirected/temperatureprovider_instance
    log-trace-log-modes=[NETWORK, CONSOLE]
    log-trace-process-desc=TemperatureProvider
    log-trace-process-id=TRPR
    state-dependent-startup-config{function-group-state=AdaptiveAppGroup.On, resource-group=Resource_group_1, startup-config=startup_config}
  process design temperatureprovider_instance_design: executable=temperatureprovider_exe
