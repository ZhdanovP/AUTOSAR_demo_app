AUTOSAR XML (schema 00048)
package /ara/demo/temperatureprovider_mapping
  process to machine mapping set TemperatureProviderInstanceToMainEcuMappingSet
    process to machine mapping TemperatureProviderInstanceToMainEcuMapping: machine=MainEcu, process=temperatureprovider_instance
  service instance to port prototype mapping TemperatureProviderInstanceToPortMapping: port-prototype=root_swc.TemperatureServicePPort, process=temperatureprovider_instance_design, service-instance=TemperatureServiceProvided
  someip service instance to machine mapping TemperatureProviderInstanceToMachineMapping: communication-connector=EthCommunicationConnector, service-instance=TemperatureServiceProvided, udp-port=5000
