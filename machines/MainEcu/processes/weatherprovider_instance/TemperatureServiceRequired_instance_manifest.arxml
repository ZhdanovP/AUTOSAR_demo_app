AUTOSAR XML (schema 00048)
package /ara/demo/weatherprovider_instance
  required someip service instance TemperatureServiceRequired: service-interface-deployment=TemperatureServiceSomeIp, required-service-instance-id=ANY, sd-client-config=ClientSomeIpSdConfig
