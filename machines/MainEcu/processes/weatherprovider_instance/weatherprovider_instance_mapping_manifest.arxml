AUTOSAR XML (schema 00048)
package /ara/demo/weatherprovider_mapping
  process to machine mapping set WeatherProviderInstanceToMainEcuMappingSet
    process to machine mapping WeatherProviderInstanceToMainEcuMapping: machine=MainEcu, process=weatherprovider_instance
  service instance to port prototype mapping WeatherProviderInstanceToPortMapping: port-prototype=root_swc.WeatherServicePPort, process=weatherprovider_instance_design, service-instance=WeatherServiceProvided
  service instance to port prototype mapping WeatherProviderInstanceToTemperaturePortMapping: port-prototype=root_swc.TemperatureServiceRPort, process=weatherprovider_instance_design, service-instance=TemperatureServiceRequired
  someip service instance to machine mapping WeatherProviderInstanceToMachineMapping: communication-connector=EthCommunicationConnector, service-instance=[WeatherServiceProvided, TemperatureServiceRequired], udp-port=5000
