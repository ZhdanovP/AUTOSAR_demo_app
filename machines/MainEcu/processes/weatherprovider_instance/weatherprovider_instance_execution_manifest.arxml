AUTOSAR XML (schema 00048)
package /ara/processes
  process weatherprovider_instance: design=weatherprovider_instance_design, executable=weatherprovider_exe, log-trace-default-log-level=VERBOSE, log-trace-file-path=/var/redirected/weatherprovider_instance, log-trace-log-modes=[NETWORK, CONSOLE], log-trace-process-desc=WeatherProvider, log-trace-process-id=WRPR, state-dependent-startup-config{function-group-state=AdaptiveAppGroup.On, resource-group=Resource_group_1, startup-config=startup_config}
  process design weatherprovider_instance_design: executable=weatherprovider_exe
