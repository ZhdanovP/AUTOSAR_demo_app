AUTOSAR XML (schema 00048)
package /ara/demo/weatherprovider_instance
  provided someip service instance WeatherServiceProvided: service-interface-deployment=WeatherServiceSomeIp, sd-server-config=ServerSomeIpSdConfig, service-instance-id=28
    someip provided event group CurrentTemperatureProvidedGroup: event-group=CurrentTemperatureGroup
