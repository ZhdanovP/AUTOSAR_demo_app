AUTOSAR XML (schema 00048)
package /ara/demo/weatherclient_mapping
  process to machine mapping set WeatherClientInstanceToMainEcuMappingSet
    process to machine mapping WeatherClientInstanceToMainEcuMapping: machine=MainEcu, process=weatherclient_instance
  service instance to port prototype mapping WeatherServiceRequiredInstanceToPortMapping: port-prototype=root_swc.WeatherServiceRPort, process=weatherclient_instance_design, service-instance=WeatherServiceRequired
  someip service instance to machine mapping WeatherServiceRequiredToMainEcuMapping: communication-connector=EthCommunicationConnector, service-instance=WeatherServiceRequired, udp-port=5000
  persistency port prototype to key value database mapping WeatherClientPortToTemperatureDatabaseMapping: key-value-storage=TemperatureDatabase, port-prototype=root_swc.WeatherClientKvsPRPort, process=weatherclient_instance
