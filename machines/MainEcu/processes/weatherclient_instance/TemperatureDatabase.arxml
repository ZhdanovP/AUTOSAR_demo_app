AUTOSAR XML (schema 00048)
package /ara/kvs_databases
  persistency key value database TemperatureDatabase: update-strategy=KEEP-EXISTING, uri=/opt/weatherclient_instance/var/temperature_database.json
