AUTOSAR XML (schema 00048)
package /ara/demo/machines
  machine SecondaryEcu: default-application-timeout={enter-timeout-value=1.0, exit-timeout-value=1.0}, machine-design=SecondaryEcuDesign
    function-groups:
      mode declaration group prototype AdaptiveAppGroup: type=AdaptiveAppGroup
      mode declaration group prototype MachineState: type=MachineState
    os module instantiation Linux
      6 x resource group:
        Resource_group_1: cpu-usage=95, mem-usage=2000000000
        Resource_group_2: cpu-usage=95, mem-usage=2000000000
        Resource_group_DB: cpu-usage=80, mem-usage=500000000
        Resource_group_DIAG: cpu-usage=80, mem-usage=500000000
        Resource_group_IAM: cpu-usage=80, mem-usage=500000000
        Resource_group_SM: cpu-usage=80, mem-usage=500000000
    ucm module instantiation UcmInstance: identifier=SecondaryEcuUCM
  machine design SecondaryEcuDesign: service-discover-configs=someip-service-discovery={multicast-sd-ip-address=ServiceDiscoveryEndpoint, someip-service-discovery-port=30491}
    ethernet communication connector EthCommunicationConnector: unicast-network-endpoint=SecondaryEcuEndpoint
