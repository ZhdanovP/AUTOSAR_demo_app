AUTOSAR XML (schema 00048)
package /ara/demo/weatherclient_instance2_mapping
  process to machine mapping set WeatherClientInstance2ToSecondaryEcuMappingSet
    process to machine mapping WeatherClientInstance2ToSecondaryEcuMapping: machine=SecondaryEcu, process=weatherclient_instance2
  service instance to port prototype mapping WeatherServiceRequiredInstanceToPortMapping: port-prototype=root_swc.WeatherServiceRPort, process=weatherclient_instance2_design, service-instance=WeatherServiceRequired
  someip service instance to machine mapping WeatherServiceRequiredToSecondaryEcuMapping: communication-connector=EthCommunicationConnector, service-instance=WeatherServiceRequired, udp-port=5000
  persistency port prototype to key value database mapping WeatherClientPortToTemperatureDatabase2Mapping: key-value-storage=TemperatureDatabase2, port-prototype=root_swc.WeatherClientKvsPRPort, process=weatherclient_instance2
