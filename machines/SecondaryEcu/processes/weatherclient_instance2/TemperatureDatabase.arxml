AUTOSAR XML (schema 00048)
package /ara/kvs_databases
  persistency key value database TemperatureDatabase2: update-strategy=KEEP-EXISTING, uri=/opt/weatherclient_instance2/var/temperature_database.json
