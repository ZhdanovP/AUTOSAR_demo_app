AUTOSAR XML (schema 00048)
package /ara/demo/weatherclient_instance2
  required someip service instance WeatherServiceRequired: service-interface-deployment=WeatherServiceSomeIp, required-service-instance-id=ANY, sd-client-config=ClientSomeIpSdConfig
    someip required event group CurrentTemperatureGroup: event-group=CurrentTemperatureGroup
