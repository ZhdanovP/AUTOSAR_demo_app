AUTOSAR XML (schema 00048)
package /ara/demo/processes
  process weatherclient_instance2: design=weatherclient_instance2_design, executable=weatherclient_exe, log-trace-default-log-level=VERBOSE, log-trace-file-path=/var/redirected/weatherclient_instance2, log-trace-log-modes=[NETWORK, CONSOLE], log-trace-process-desc=WeatherClient, log-trace-process-id=WRCL, state-dependent-startup-config{function-group-state=AdaptiveAppGroup.On, resource-group=Resource_group_1, startup-config=startup_config}
  process design weatherclient_instance2_design: executable=weatherclient_exe
