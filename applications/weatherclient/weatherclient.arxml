AUTOSAR XML (schema 00048)
package /ara/demo/applications
  adaptive application sw component type weatherclient
    require port WeatherServiceRPort: required-interface=WeatherService
    provide/require port WeatherClientKvsPRPort: provided-required-interface=WeatherClientKvsInterface
package /ara/demo/executables
  executable weatherclient_exe: category=APPLICATION_LEVEL, build-type=BUILD-TYPE-DEBUG, logging-behavior=USES-LOGGING, minimum-timer-granularity=1000.0
    root sw component prototype root_swc: application-type=weatherclient
