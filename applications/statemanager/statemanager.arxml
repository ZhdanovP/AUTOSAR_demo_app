AUTOSAR XML (schema 00048)
package /ara/executables
  executable statemanager: category=APPLICATION_LEVEL, build-type=BUILD-TYPE-DEBUG, logging-behavior=USES-LOGGING, minimum-timer-granularity=1000.0
