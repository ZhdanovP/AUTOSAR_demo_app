AUTOSAR XML (schema 00048)
package /ara/datatypes/cppimplementationdatatypes
  std cpp implementation data type TemperatureType: type-emitter=TYPE_EMITTER_ARA, type-reference=uint8_t
    namespaces:
      symbol props ara
      symbol props demo
  std cpp implementation data type DateType: category=STRING, type-emitter=TYPE_EMITTER_ARA
    namespaces:
      symbol props ara
      symbol props demo
  std cpp implementation data type ForecastType: category=STRING, type-emitter=TYPE_EMITTER_ARA
    namespaces:
      symbol props ara
      symbol props demo
package /AUTOSAR/StdTypes
  13 x std cpp implementation data type:
    ByteArray: category=VECTOR, cpp-template-argument=uint8_t, type-emitter=TYPE_EMITTER_ARA
    String: category=STRING, type-emitter=TYPE_EMITTER_ARA
    bool: category=VALUE
    double: category=VALUE
    float: category=VALUE
    int16_t: category=VALUE, type-emitter=cstdint
    int32_t: category=VALUE, type-emitter=cstdint
    int64_t: category=VALUE, type-emitter=cstdint
    int8_t: category=VALUE, type-emitter=cstdint
    uint16_t: category=VALUE, type-emitter=cstdint
    uint32_t: category=VALUE, type-emitter=cstdint
    uint64_t: category=VALUE, type-emitter=cstdint
    uint8_t: category=VALUE, type-emitter=cstdint
