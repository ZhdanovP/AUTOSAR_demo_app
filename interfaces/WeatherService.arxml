AUTOSAR XML (schema 00048)
package /ara/serviceinterfaces
  service interface WeatherService
    namespaces:
      symbol props ara
      symbol props demo
    field CurrentTemperature: type=TemperatureType, has-getter=true, has-notifier=true, has-setter=false
    methods:
      operation GetWeatherForecast: fire-and-forget=false
        arg Date: type=DateType, direction=IN
        arg Forecast: type=ForecastType, direction=OUT
