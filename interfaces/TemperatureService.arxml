AUTOSAR XML (schema 00048)
package /ara/serviceinterfaces
  service interface TemperatureService
    namespaces:
      symbol props ara
      symbol props demo
    methods:
      operation GetCurrentTemperature: fire-and-forget=false
        arg Temperature: type=TemperatureType, direction=OUT
