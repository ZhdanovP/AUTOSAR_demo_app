AUTOSAR XML (schema 00048)
package /ara/kvs_interfaces
  persistency key value database interface WeatherClientKvsInterface: redundancy=NONE, update-strategy=KEEP-EXISTING, data-type-for-serialization=TemperatureType
