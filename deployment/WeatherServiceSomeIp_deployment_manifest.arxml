AUTOSAR XML (schema 00048)
package /ara/demo/deployment
  someip service interface deployment WeatherServiceSomeIp: service-interface=WeatherService, service-interface-id=115, service-interface-version={major-version=1, minor-version=0}
    someip field deployment CurrentTemperature: field=CurrentTemperature
      get Getter: method-id=3101, transport-protocol=UDP
      notifier Notifier: event-id=4101, transport-protocol=UDP
    someip method deployment GetWeatherForecast: method=GetWeatherForecast, method-id=3106, transport-protocol=UDP
    someip event group CurrentTemperatureGroup: event-group-id=4501, event=Notifier
