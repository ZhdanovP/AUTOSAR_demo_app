AUTOSAR XML (schema 00048)
package /ara/demo/deployment
  someip service interface deployment TemperatureServiceSomeIp: service-interface=TemperatureService, service-interface-id=116, service-interface-version={major-version=1, minor-version=0}
    someip method deployment GetCurrentTemperature: method=GetCurrentTemperature, method-id=4106, transport-protocol=UDP
